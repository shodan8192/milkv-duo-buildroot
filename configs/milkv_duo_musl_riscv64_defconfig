## configs/milkv_duo_musl_riscv64_defconfig
```kconfig
# Architecture
BR2_riscv=y
BR2_riscv_g=y
BR2_RISCV_ISA_RVC=y

# Linux headers same as kernel 5.10 series
BR2_KERNEL_HEADERS_5_10=y

# Using gcc13 to have t-head's optimization and features
BR2_GCC_VERSION_13_X=y
BR2_TOOLCHAIN_BUILDROOT_CXX=y
BR2_TOOLCHAIN_BUILDROOT_MUSL=y
BR2_TARGET_OPTIMIZATION="-march=rv64imafdc_xtheadba_xtheadbb_xtheadbs_xtheadcmo_xtheadcondmov_xtheadfmemidx_xtheadfmv_xtheadint_xtheadmac_xtheadmemidx_xtheadmempair_xtheadsync"
BR2_TARGET_LDFLAGS="-march=rv64imafdc_xtheadba_xtheadbb_xtheadbs_xtheadcmo_xtheadcondmov_xtheadfmemidx_xtheadfmv_xtheadint_xtheadmac_xtheadmemidx_xtheadmempair_xtheadsync"

# opensbi
BR2_TARGET_OPENSBI=y
BR2_TARGET_OPENSBI_CUSTOM_GIT=y
BR2_TARGET_OPENSBI_CUSTOM_REPO_URL="https://github.com/milkv-duo/milkv-duo-opensbi.git"
BR2_TARGET_OPENSBI_CUSTOM_REPO_VERSION="ee78f99daf8ac5956c6bf95458983ead52142548"
BR2_TARGET_OPENSBI_PLAT="generic"
BR2_TARGET_OPENSBI_UBOOT_PAYLOAD=y
BR2_TARGET_OPENSBI_FW_FDT_PATH=y

# u-boot
BR2_TARGET_UBOOT=y
BR2_TARGET_UBOOT_BUILD_SYSTEM_KCONFIG=y
BR2_TARGET_UBOOT_CUSTOM_GIT=y
BR2_TARGET_UBOOT_CUSTOM_REPO_URL="https://github.com/milkv-duo/milkv-duo-u-boot.git"
BR2_TARGET_UBOOT_CUSTOM_REPO_VERSION="v2021.10_ion"
BR2_TARGET_UBOOT_BOARD_DEFCONFIG="cvitek_cv1800b_milkv_duo_sd"
BR2_TARGET_UBOOT_NEEDS_DTC=y
BR2_TARGET_UBOOT_NEEDS_OPENSBI=y

# Kernel
BR2_LINUX_KERNEL=y
BR2_LINUX_KERNEL_CUSTOM_GIT=y
BR2_LINUX_KERNEL_CUSTOM_REPO_URL="https://github.com/milkv-duo/milkv-duo-linux.git"
BR2_LINUX_KERNEL_CUSTOM_REPO_VERSION="duo-linux-5.10.4"
BR2_LINUX_KERNEL_DEFCONFIG="cvitek_cv1800b_milkv_duo_sd"
BR2_LINUX_KERNEL_LZMA=y

# SD card image generating script
BR2_ROOTFS_POST_IMAGE_SCRIPT="board/milkv/duo/post-image.sh"

# Packages for the sdcard image generating
BR2_PACKAGE_MILKV_DUO_FIRMWARE_FSBL=y
BR2_PACKAGE_MILKV_DUO_SMALLCORE_FREERTOS=y
BR2_PACKAGE_MILKV_DUO_PINMUX=y

# Host packages for the sdcard image generating
BR2_PACKAGE_HOST_DOSFSTOOLS=y
BR2_PACKAGE_HOST_GENIMAGE=y
BR2_PACKAGE_HOST_LZMA_ALONE=y
BR2_PACKAGE_HOST_MTOOLS=y
BR2_PACKAGE_HOST_UBOOT_TOOLS=y
BR2_PACKAGE_HOST_UBOOT_TOOLS_FIT_SUPPORT=y
```

## package/milkv-duo-firmware-fsbl/Config.in
```kconfig
config BR2_PACKAGE_MILKV_DUO_FIRMWARE_FSBL
	bool "milkv-duo-firmware-fsbl"
	depends on BR2_riscv
	select BR2_PACKAGE_HOST_MTOOLS
	help
	  This package is obtained from
	  https://github.com/milkv-duo/duo-buildroot-sdk,
	  from which we download the first stage bootloader source and
	  compile it, generating the atf bl2.bin. At the mean time, we
	  will use the fiptool.py in this package to create the binary
	  file fip.bin to pack the opensbi, u-boot and so on.

	  If you are using Buildroot to generate the whole SD card
	  Image or the fip.bin, you must say Y to this package!

	  https://github.com/gtxzsxxk/milkv-duo-firmware-fsbl

if BR2_PACKAGE_MILKV_DUO_FIRMWARE_FSBL

config BR2_PACKAGE_MILKV_DUO_FIRMWARE_FSBL_64MB
	bool "64 MiB Free RAM"
	default n
	help
	  Say Y to this will disable the ION in order to
	  have the all 64MiB Free memory.

config BR2_PACKAGE_MILKV_DUO_PINMUX
	bool "duo-pinmux tool"
	default n
	help
	  Say Y to this will compile the duo-pinmux, which can
	  get or set function of any Milk-V Duo GPIO Pin. More info at

	  https://milkv.io/docs/duo/application-development/pinmux

	  https://github.com/shodan8192/milkv-duo-pinmux

config BR2_PACKAGE_MILKV_DUO_FEATURES
	bool "Duo USB Features"
	default n
	select BR2_PACKAGE_GREP
	select BR2_PACKAGE_TREE
	select BR2_PACKAGE_DHCPCD
	select BR2_PACKAGE_DNSMASQ
	select BR2_PACKAGE_DROPBEAR
	select BR2_PACKAGE_LRZSZ
	select BR2_PACKAGE_NEOFETCH
	select BR2_PACKAGE_WHICH
	select BR2_PACKAGE_HTOP
	help
	  Say Y to this will copy the cvitek usb shell scripts to have
	  the USB features. The role could be configured at

	  /etc/milkv-duo.conf

	  Supported usb functions are rndis, host and mass-storage.
	  By default Duo has the LED blinking. It could be configured
	  in that conf file as well. Say Y to this will also select
	  some packages automatically, to have the same experience
	  with the official release.

endif
```

## package/milkv-duo-libraries/Config.in
```kconfig
config BR2_PACKAGE_MILKV_DUO_LIBRARIES
	bool "milk-v duo libraries"
	depends on BR2_riscv
	help
	  Those packages provide board-specific hardware tools and
	  firmware for the Milk-V Duo platform.

if BR2_PACKAGE_MILKV_DUO_LIBRARIES

config BR2_PACKAGE_MILKV_DUO_FIRMWARE_FSBL
	bool "milkv-duo-firmware-fsbl"
	select BR2_PACKAGE_HOST_MTOOLS
	help
	  This package is obtained from
	  https://github.com/milkv-duo/duo-buildroot-sdk,
	  from which we download the first stage bootloader source and
	  compile it, generating the atf bl2.bin. At the mean time, we
	  will use the fiptool.py in this package to create the binary
	  file fip.bin to pack the opensbi, u-boot and so on.

	  If you are using Buildroot to generate the whole SD card
	  Image or the fip.bin, you must say Y to this package!

	  https://github.com/gtxzsxxk/milkv-duo-firmware-fsbl

config BR2_PACKAGE_MILKV_DUO_FIRMWARE_FSBL_64MB
	bool "64 MiB Free RAM"
	depends on BR2_PACKAGE_MILKV_DUO_FIRMWARE_FSBL
	default n
	help
	  Say Y to this will disable the ION in order to
	  have the all 64MiB Free memory.

config BR2_PACKAGE_MILKV_DUO_PINMUX
	bool "duo-pinmux tool"
	default n
	help
	  Say Y to this will compile the duo-pinmux, which can
	  get or set function of any Milk-V Duo GPIO Pin. More info at

	  https://milkv.io/docs/duo/application-development/pinmux

	  https://github.com/shodan8192/milkv-duo-pinmux

config BR2_PACKAGE_MILKV_DUO_FEATURES
	bool "Duo USB Features"
	default n
	select BR2_PACKAGE_GREP
	select BR2_PACKAGE_TREE
	select BR2_PACKAGE_DHCPCD
	select BR2_PACKAGE_DNSMASQ
	select BR2_PACKAGE_DROPBEAR
	select BR2_PACKAGE_LRZSZ
	select BR2_PACKAGE_NEOFETCH
	select BR2_PACKAGE_WHICH
	select BR2_PACKAGE_HTOP
	help
	  Say Y to this will copy the cvitek usb shell scripts to have
	  the USB features. The role could be configured at

	  /etc/milkv-duo.conf

	  Supported usb functions are rndis, host and mass-storage.
	  By default Duo has the LED blinking. It could be configured
	  in that conf file as well. Say Y to this will also select
	  some packages automatically, to have the same experience
	  with the official release.

endif
```

## package/wiringx/Config.in
```kconfig
config BR2_PACKAGE_WIRINGX
	bool "wiringX"
	help
	  wiringX is a cross-platform GPIO interface that allows
	  developers to control the GPIO of various platforms with
	  generic and uniform functions. By using wiringX, the same
	  code will run on all platforms supported by wiringX.

	  Supported vendors:

	  allwinner = <a10, a31s, h3, h5>
	  amlogic = <s805, s905>
	  broadcom = <bcm2711, bcm2835, bcm2836>
	  nXP = <imx6dqrm, imx6sdlrm>
	  rockchip = <rk3399>
	  samsung = <exynos5422>

	  https://wiringx.org/
```
